## CMakeLists.txt
```
cmake_minimum_required(VERSION 3.13.1)

include(zeta.cmake NO_POLICY_SCOPE)
find_package(Zephyr HINTS $ENV{ZEPHYR_BASE})
project(tcc-robot)

set(CMAKE_EXPORT_COMPILE_COMMANDS ON)

include_directories(${HEADERS})
target_sources(app PRIVATE ${SOURCES})
```

## prj.conf
```kconfig
CONFIG_LOG=y
CONFIG_ZETA_LOG_LEVEL_DBG=y
CONFIG_ENTROPY_GENERATOR=y
CONFIG_TEST_RANDOM_GENERATOR=y
```

## src/core.c
```c
#include <logging/log.h>
#include <zephyr.h>
#include <zeta.h>

LOG_MODULE_DECLARE(zeta, CONFIG_ZETA_LOG_LEVEL);

K_MSGQ_DEFINE(CORE_msgq, sizeof(zt_channel_e), 20, 4);

u8_t running_flag = 0;

void bug0(u8_t pos_x_initial, u8_t pos_y_initial, u8_t pos_x_final, u8_t pos_y_final,
          u8_t obstacle)
{
    static enum { GOING_TO_INITIAL_SHELF, GOING_TO_FINAL_SHELF, FINISH } state = FINISH;

    switch (state) {
    case FINISH: {
        state = GOING_TO_INITIAL_SHELF;
        LOG_DBG("Going to the initial shelf...");
    } break;
    case GOING_TO_INITIAL_SHELF: {
        if (obstacle) {
            LOG_DBG("Wall following...");
        } else {
            LOG_DBG("Going to the point...");
        }
        zt_data_t *wheel_data      = ZT_DATA_BYTES(2, 0);
        wheel_data->bytes.value[0] = sys_rand32_get() % 3;
        wheel_data->bytes.value[1] = sys_rand32_get() % 3;
        zt_chan_pub(ZT_WHEEL_DATA_CHANNEL, wheel_data);
        if (!obstacle) {
            if ((sys_rand32_get() % 100) < 10) {
                LOG_DBG("Reached to the initial shelf");
                LOG_DBG("Going to the final shelf");
                state = GOING_TO_FINAL_SHELF;
            }
        }
    } break;
    case GOING_TO_FINAL_SHELF: {
        if (obstacle) {
            LOG_DBG("Wall following...");
        } else {
            LOG_DBG("Going to the point...");
        }
        zt_data_t *wheel_data      = ZT_DATA_BYTES(2, 0);
        wheel_data->bytes.value[0] = sys_rand32_get() % 3;
        wheel_data->bytes.value[1] = sys_rand32_get() % 3;
        zt_chan_pub(ZT_WHEEL_DATA_CHANNEL, wheel_data);
        if (!obstacle) {
            if ((sys_rand32_get() % 100) < 10) {
                LOG_DBG("Reached to the final shelf...");
                LOG_DBG("Robot job has been finished...");
                running_flag            = 0;
                zt_data_t *running_data = ZT_DATA_U8(running_flag);
                zt_chan_pub(ZT_RUNNING_CHANNEL, running_data);
                state = FINISH;
            }
        }
        break;
    }
    }
}

/**
 * @brief This is the function used by Zeta to tell the CORE that one(s) of the
 * channels which it is subscribed has changed. This callback will be called passing
 * the channel's id in it.
 *
 * @param id
 */
void CORE_service_callback(zt_channel_e id)
{
    k_msgq_put(&CORE_msgq, &id, K_NO_WAIT);
}

/**
 * @brief This is the task loop responsible to run the CORE thread
 * functionality.
 */
void CORE_task()
{
    LOG_DBG("CORE Service has started...[OK]");
    zt_data_t *request_data    = ZT_DATA_BYTES(4, 0);
    zt_data_t *obstacle_sensor = ZT_DATA_U8(0);
    zt_data_t *battery         = ZT_DATA_U8(0);
    u8_t obstacle              = 0;
    zt_channel_e id;
    while (1) {
        while (!k_msgq_get(&CORE_msgq, &id, K_MSEC(50))) {
            switch (id) {
            case ZT_SHELF_REQUEST_CHANNEL: {
                LOG_DBG("Robot job will start...");
                running_flag            = 1;
                zt_data_t *running_data = ZT_DATA_U8(running_flag);
                zt_chan_pub(ZT_RUNNING_CHANNEL, running_data);
            } break;
            case ZT_BATTERY_DATA_CHANNEL: {
                zt_chan_read(ZT_BATTERY_DATA_CHANNEL, battery);
                if (battery->u8.value < 30) {
                    LOG_DBG("Critical battery level %d", battery->u8.value);
                    zt_data_t *charge_request = ZT_DATA_U8(1);
                    zt_chan_pub(ZT_CHARGE_REQUEST_CHANNEL, charge_request);
                }
            } break;
            case ZT_OBSTACLE_DATA_CHANNEL: {
                zt_chan_read(ZT_OBSTACLE_DATA_CHANNEL, obstacle_sensor);
                if (obstacle_sensor->u8.value < 10) {
                    LOG_DBG("Obstacle detected");
                    obstacle = 1;
                }
            } break;
            default:
                break;
            }
        }

        if (running_flag) {
            bug0(request_data->bytes.value[0], request_data->bytes.value[1],
                 request_data->bytes.value[2], request_data->bytes.value[3], obstacle);
            obstacle = 0;
        }
    }
}


ZT_SERVICE_INIT(CORE, CORE_task, CORE_service_callback);
```

## src/net.c
```c
#include <logging/log.h>
#include <zephyr.h>
#include <zeta.h>

LOG_MODULE_DECLARE(zeta, CONFIG_ZETA_LOG_LEVEL);

K_MSGQ_DEFINE(NET_msgq, sizeof(zt_channel_e), 50, 4);

u32_t request_fetch(void)
{
    return sys_rand32_get() % 100;
}

/**
 * @brief This is the function used by Zeta to tell the NET that one(s) of the
 * channels which it is subscribed has changed. This callback will be called passing the
 * channel's id in it.
 *
 * @param id
 */
void NET_service_callback(zt_channel_e id)
{
    k_msgq_put(&NET_msgq, &id, K_NO_WAIT);
}

/**
 * @brief This is the task loop responsible to run the NET thread
 * functionality.
 */
void NET_task()
{
    LOG_DBG("NET Service has started...[OK]");
    zt_data_t *running_flag = ZT_DATA_U8(0);
    zt_data_t *request_data = ZT_DATA_BYTES(4, 0);
    zt_channel_e id;
    while (1) {
        while (!k_msgq_get(&NET_msgq, &id, K_MSEC(50))) {
            switch (id) {
            case ZT_CHARGE_REQUEST_CHANNEL: {
                LOG_DBG("Sending packet \"The robot need to be charged\"");
            } break;
            case ZT_RUNNING_CHANNEL: {
                zt_chan_read(ZT_RUNNING_CHANNEL, running_flag);
                if (!running_flag->u8.value) {
                    LOG_DBG("Sending packet \"The SHELF_REQUEST has been executed...\"");
                }
            } break;
            default:
                break;
            }
        }
        if (!running_flag->u8.value) {
            request_data->u32.value = request_fetch();
            if (request_data) {
                LOG_DBG("SHELF_REQUEST has been received...");
                zt_chan_pub(ZT_SHELF_REQUEST_CHANNEL, request_data);
            }
        }
    }
}

ZT_SERVICE_INIT(NET, NET_task, NET_service_callback);
```

## src/sensor.c
```c
#include <logging/log.h>
#include <zephyr.h>
#include <zeta.h>
#include <random/rand32.h>

LOG_MODULE_DECLARE(zeta, CONFIG_ZETA_LOG_LEVEL);

K_SEM_DEFINE(SENSOR_callback_sem, 0, 1);


u8_t obstacle_sensor_fetch(void)
{
    return sys_rand32_get() % 100;
}

u8_t battery_fetch(void)
{
    return sys_rand32_get() % 100;
}


/**
 * @brief This is the function used by Zeta to tell the SENSOR that one(s) of the
 * channels which it is subscribed has changed. This callback will be called passing the
 * channel's id in it.
 *
 * @param id
 */
void SENSOR_service_callback(zt_channel_e id)
{
    k_sem_give(&SENSOR_callback_sem);
}

/**
 * @brief This is the task loop responsible to run the SENSOR thread
 * functionality.
 */
void SENSOR_task()
{
    LOG_DBG("SENSOR Service has started...[OK]");
    zt_data_t* running_flag    = ZT_DATA_U8(0);
    zt_data_t* obstacle_sensor = ZT_DATA_U8(0);
    zt_data_t* battery         = ZT_DATA_U8(0);
    while (1) {
        if (!k_sem_take(&SENSOR_callback_sem, K_MSEC(50))) {
            zt_chan_read(ZT_RUNNING_CHANNEL, running_flag);
        }
        if (running_flag->u8.value) {
            obstacle_sensor->u8.value = obstacle_sensor_fetch();
            LOG_DBG("Sending obstacle sensor data...");
            zt_chan_pub(ZT_OBSTACLE_DATA_CHANNEL, obstacle_sensor);
        } else {
            battery->u8.value = battery_fetch();
            LOG_DBG("Sending battery data...");
            zt_chan_pub(ZT_BATTERY_DATA_CHANNEL, battery);
        }
    }
}

ZT_SERVICE_INIT(SENSOR, SENSOR_task, SENSOR_service_callback);
```

## src/two_wheel.c
```c
#include <logging/log.h>
#include <zephyr.h>
#include <zeta.h>

LOG_MODULE_DECLARE(zeta, CONFIG_ZETA_LOG_LEVEL);

K_SEM_DEFINE(TWO_WHEEL_callback_sem, 0, 1);

void motors_action(u8_t left_wheel, u8_t right_wheel)
{
    if (left_wheel < right_wheel) {
        LOG_DBG("Turning left...");
    } else if (left_wheel > right_wheel) {
        LOG_DBG("Turning right...");
    } else if (left_wheel != 0) {
        LOG_DBG("Fowarding...");
    } else {
        LOG_DBG("Stoping...");
    }
}


/**
 * @brief This is the function used by Zeta to tell the TWO_WHEEL that one(s) of the
 * channels which it is subscribed has changed. This callback will be called passing the
 * channel's id in it.
 *
 * @param id
 */
void TWO_WHEEL_service_callback(zt_channel_e id)
{
    k_sem_give(&TWO_WHEEL_callback_sem);
}

/**
 * @brief This is the task loop responsible to run the TWO_WHEEL thread
 * functionality.
 */
void TWO_WHEEL_task()
{
    LOG_DBG("TWO_WHEEL Service has started...[OK]");
    zt_data_t *wheel_data = ZT_DATA_U16(0);
    while (1) {
        k_sem_take(&TWO_WHEEL_callback_sem, K_FOREVER);
        zt_chan_read(ZT_WHEEL_DATA_CHANNEL, wheel_data);
        motors_action(wheel_data->bytes.value[0], wheel_data->bytes.value[1]);
    }
}

ZT_SERVICE_INIT(TWO_WHEEL, TWO_WHEEL_task, TWO_WHEEL_service_callback);
```
